## board/nanobox/nano-box_defconfig
```kconfig
BR2_arm=y
BR2_TOOLCHAIN_BUILDROOT_UCLIBC=y
BR2_TOOLCHAIN_BUILDROOT_CXX=y
BR2_TARGET_GENERIC_HOSTNAME="nano-box"
BR2_TARGET_GENERIC_ISSUE="Welcome to nano-box"
BR2_TARGET_GENERIC_ROOT_PASSWD="12345"
BR2_LINUX_KERNEL=y
BR2_LINUX_KERNEL_CUSTOM_VERSION=y
BR2_LINUX_KERNEL_CUSTOM_VERSION_VALUE="6.4.7"
BR2_LINUX_KERNEL_USE_CUSTOM_CONFIG=y
BR2_LINUX_KERNEL_CUSTOM_CONFIG_FILE="board/nanobox/nano-box_defconfig"
BR2_LINUX_KERNEL_DTS_SUPPORT=y
BR2_LINUX_KERNEL_CUSTOM_DTS_PATH="board/nanobox/nano-box.dts"
BR2_LINUX_KERNEL_DTB_OVERLAY_SUPPORT=y
BR2_PACKAGE_BUSYBOX_SHOW_OTHERS=y
BR2_PACKAGE_DIRECTFB=y
BR2_PACKAGE_DIRECTFB_EXAMPLES=y
BR2_PACKAGE_FB_TEST_APP=y
BR2_PACKAGE_SDL=y
# BR2_PACKAGE_SDL_FBCON is not set
BR2_PACKAGE_SDL_DIRECTFB=y
BR2_PACKAGE_SDL2=y
BR2_PACKAGE_SDL2_DIRECTFB=y
BR2_PACKAGE_OPENSSH=y
BR2_TARGET_UBOOT=y
BR2_TARGET_UBOOT_BOARD_DEFCONFIG="licheepi_nano"
BR2_TARGET_UBOOT_SPL=y
```
